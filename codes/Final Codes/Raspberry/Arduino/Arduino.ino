#include <Servo.h>
#include <avr/pgmspace.h>

//byte counter = 0;
byte led = 0;
const byte velocityCoeff = 3; // Enter speed between 1 (fastest)-10(slowest)
//const byte slowingPos = 5; // Decrease speed at specified position (slowingPos) before desired angle
//const byte decreaseCoef = 2; // how many times to decrease speed at specified position
byte slowedFlag[2] = {0};
Servo myservo[3];  // create servo object to control a servo
int16_t pos[2] =  { 0 };    // variable to store the servo position
byte finishFlag[2] =  {2,2}; // flag to save last command execution status. 0 - busy, 1 - done, 2 - ready
int16_t duration[2]; // variable to store delays between position
unsigned long curtime[2]= {0,0}; // variable to store last command execution time
unsigned long j=0;
//const int16_t positions2 [10000] PROGMEM = {251,251,1084,740,252,252,1094,750,1094,754,1099,764,1099,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251
//};
//uint16_t positions [1000][2] = {0};
unsigned int counter = 0;

//updater variables
#define bufferSize 20 //number of bytes to store in the serial buffer
#define ramSize 200 //number of times to copy serial buffer to array
int bufferCounter = 0;
int ramCounter = 0;
int rcHigh,rcLow; //received byte.
void updater();
uint16_t index=0;
int16_t positions[bufferSize*ramSize/4][2] = {0};
//


void setup() {
  pinMode(LED_BUILTIN, OUTPUT);
  digitalWrite(LED_BUILTIN, LOW);
  Serial.begin(115200);
  
  myservo[0].attach(2);  // attaches the servo on pin 2 to the servo object (alpha)
  myservo[1].attach(4);   // attaches the servo on pin 4 to the servo object (beta)
  myservo[2].attach(6);   // attaches the servo on pin 6 to the servo object (z)
  
  myservo[2].write(89); //initially lift the pen
  delay(2000);
  pos[0]=1200; //zero positions for arms
  myservo[0].writeMicroseconds(pos[0]);
  pos[1]=1200;
  myservo[1].writeMicroseconds(pos[1]);
  Serial.print('r'); //request data
  delay(2000);
  updater();
}
 

void writemotor (short int motor, short int angle) {
  if (finishFlag[motor]==2) {
    
    if (abs(angle - pos[motor])>=2) {   
        duration[motor]=velocityCoeff*max(abs(pos[0]-positions[j][0]),abs(pos[1]-positions[j][1]))/abs(angle-pos[motor]);        
        finishFlag[motor] = 0;
    }
    else 
      finishFlag[motor]= 1;          
  }
    
  if( (finishFlag[motor]==0) && ((millis()-curtime[motor])>duration[motor])){
     
     if (angle-pos[motor]>=2){      
       pos[motor]+=2;       
       myservo[motor].write(pos[motor]);  
       curtime[motor]=millis();
     }
    
     else if (angle-pos[motor]<=-2){          
       pos[motor]-=2;
       myservo[motor].write(pos[motor]); 
       curtime[motor]=millis();       
    }

     else 
      finishFlag[motor]= 1;   
   }
}

void liftPen() {                //lifting the pen with 3rd motor
   myservo[2].write(89);
   delay(70);
}

void lowerPen() {               //lowering the pen with 3rd motor
   delay(20);
   myservo[2].write(14);
   delay(150);
}


void updater(){ 
 if(j%5==0){
  static byte flag=0;
  j=0;
  index=0;
  ramCounter=0;
  //Serial.print('r'); //request data
  
    while(Serial.available()<bufferSize) //wait until buffer is full
    {}
      
    for (bufferCounter=0;bufferCounter<bufferSize;bufferCounter+=2){
         rcHigh = Serial.read();
         rcHigh = rcHigh << 8;
         rcLow = Serial.read();
         rcHigh = rcHigh + rcLow;
         positions[index][flag]= rcHigh;           
         flag=!flag;
         if(!flag)
           index++;         
     }
      
     if (positions[index-1][!flag] == 253) //end of the file
           return; //exit loop
      
     Serial.print('r');    
 }
  /*
  if(j%1000==0){
      j=0;
      int i=0;
      for (i=0;i<1000;i++){
         positions[i][0] = (uint16_t)(pgm_read_word_near(positions2 + 2*(counter*1000 + i)));
         positions[i][1] = (uint16_t)(pgm_read_word_near(positions2 + 2*(counter*1000 + i) + 1));
      }
    counter++;    
    }
    */
}

void loop() {
    while(positions[j][0]>250 && positions[j][0]<=255) {
      if(positions[j][0]==251){               //lift code is 251, alpha and beta should be 251 
        liftPen();
        j++;
        updater();
      }
      else if(positions[j][0]==252){          //lower code is 252, alpha and beta should be 252 
        lowerPen();
        j++;
        updater();
      }
      else if(positions[j][0]==253){          //end code is 253, alpha and beta should be 253
        liftPen();
        while(1){};
      }
    }
    
writemotor(0,positions[j][0]);
writemotor(1,positions[j][1]);

  if (finishFlag[0] && finishFlag[1]) {
    j++;
    updater();
    finishFlag[0] = 2;
    finishFlag[1] = 2;    
    }
}
