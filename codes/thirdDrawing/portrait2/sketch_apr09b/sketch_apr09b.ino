
#include <Servo.h>
#include <avr/pgmspace.h>

short int led = 0;
short int velocityCoeff=5; // Enter speed between 1 (fastest)-10(slowest) 
Servo myservo[3];  // create servo object to control a servo
short int pos[2] =  { 0 };    // variable to store the servo position
short int finishFlag[2] = {2,2}; // flag to save last command execution status. 0 - busy, 1 - done, 2 - ready
int duration[2]; // variable to store delays between position
unsigned long curtime[2]= {0,0}; // variable to store last command execution time
unsigned long j=0;
const uint8_t positions2 [16000] PROGMEM = {251,251,49,12,252,252,50,15,52,18,52,19,51,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251
};
uint8_t positions [1000][2] = {0};
unsigned int counter = 0;
unsigned int counter2 = 0;

void setup() {
  pinMode(LED_BUILTIN, OUTPUT);
  digitalWrite(LED_BUILTIN, LOW);
  Serial.begin(9600);
  
  myservo[0].attach(2,604,2350);  // attaches the servo on pin 2 to the servo object (alpha)
  myservo[1].attach(4,604,2350);   // attaches the servo on pin 4 to the servo object (beta)
  myservo[2].attach(6);   // attaches the servo on pin 6 to the servo object (z)
  
  myservo[2].write(89); //initially lift the pen
  delay(5000);
  pos[0]=100; //zero positions for arms
  myservo[0].write(pos[0]);
  pos[1]=50;
  myservo[1].write(pos[1]);
  updater();
}
 

void writemotor (short int motor, short int angle) {
  if (finishFlag[motor]==2) {
    
    if (angle != pos[motor]) {   
        duration[motor]=velocityCoeff*max(abs(positions[j][0]-pos[0]),abs(positions[j][1]-pos[1]))/(abs(angle-pos[motor]));
        finishFlag[motor] = 0;
    }
    else 
      finishFlag[motor]= 1;    
      
  }
    
  if( (finishFlag[motor]==0) && ((millis()-curtime[motor])>duration[motor])){

     
     if (pos[motor]<angle){
       pos[motor]+=1;
       myservo[motor].write(pos[motor]);
       curtime[motor]=millis();
     }
    
     else if (pos[motor]>angle){      
       pos[motor]-=1;
       myservo[motor].write(pos[motor]);
       curtime[motor]=millis();       
    }

     else 
      finishFlag[motor]= 1;    
          
   }
}

void liftPen() {                //lifting the pen with 3rd motor
   myservo[2].write(89);
   delay(100);
}

void lowerPen() {               //lowering the pen with 3rd motor
   delay(100);
   myservo[2].write(14);
   delay(100);
}


void updater(){
  if(j%1000==0){
      j=0;
      int i=0;
      for (i=0;i<1000;i++){
         positions[i][0] = (byte)(pgm_read_word_near(positions2 + 2*(counter*1000 + i)));
         positions[i][1] = (byte)(pgm_read_word_near(positions2 + 2*(counter*1000 + i) + 1));
//         Serial.println(positions[i][0]);
//         Serial.println(positions[i][1]);
      }
    counter++;    
    }
}

void loop() {
    while(positions[j][0]>250) {
      if(positions[j][0]==251){               //lift code is 251, alpha and beta should be 251 
        liftPen();
        j++;
        updater();
      }
      else if(positions[j][0]==252){          //lower code is 252, alpha and beta should be 252 
        lowerPen();
        j++;
        updater();
      }
      else if(positions[j][0]==253){          //end code is 253, alpha and beta should be 253
        liftPen();
        while(1){};
      }
    }
    
writemotor(0,positions[j][0]);
writemotor(1,positions[j][1]);

  if (finishFlag[0] && finishFlag[1]) {
    j++;
    updater();
    finishFlag[0] = 2;
    finishFlag[1] = 2;    
    }
}
